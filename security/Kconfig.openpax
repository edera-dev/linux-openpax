## security/Kconfig.openpax
```kconfig
#
# OpenPaX configuration
#

menu "OpenPaX options"

config OPENPAX
	bool "Enable OpenPaX features"
	default y
	help
	  This configuration setting enables OpenPaX features.
	  OpenPaX adds memory safety-related defenses to the kernel which
	  reduce the risks posed by exploitable memory safety bugs.

config OPENPAX_SOFTMODE
	bool "Support PaX soft mode"
	default y
	help
	  Enabling this option will allow you to configure OpenPaX
	  features to run in soft mode.  In this mode, OpenPaX features
	  will be disabled by default, only running on applications
	  which explicitly enable them.
	
	  Soft mode can be enabled via the kernel.pax.softmode sysctl,
	  or the pax_softmode=1 kernel command-line option.

config OPENPAX_XATTR_PAX_FLAGS
	bool "Use filesystem extended attributes to modify OpenPaX features"
	depends on OPENPAX
	default y
	help
	  Enabling this option will allow you to control whether
	  OpenPaX features are enabled on a per-executable basis via
	  xattr attributes.
	
	  For compatibility with the original PaX patch, the feature
	  flags are read from the user.pax.flags extended attribute.
	
	  If you disable this feature, then all applications will run
	  with OpenPaX enabled by default.

config OPENPAX_MPROTECT
	bool "Enforce W^X for memory mappings"
	depends on OPENPAX
	default y
	help
	  Enabling this option prevents programs from making pages
	  executable when they are also writable.  In addition, it
	  also denies transition of writable mappings to executable
	  mappings.
	
	  This feature is known to break programs which depend on
	  just-in-time (JIT) compilation.  It is advisable to enable
	  this feature system-wide, but mark programs which have
	  JIT compilation appropriately so the W^X enforcement is
	  disabled for them.

config OPENPAX_EMUTRAMP
	bool "Emulate stack and heap trampolines"
	depends on OPENPAX
	default y
	help
	  Enabling this option allows programs to depend on common
	  types of stack and heap trampolines (such as the ones
	  generated by GCC and libffi) to continue working despite
	  the stack and heap being non-executable memory.
	
	  This option works by intercepting the page faults caused
	  by executing code in non-executable memory and emulating
	  the side effects that would have happened from executing
	  the trampoline.
	
	  Most likely, you should say 'y' here.

config OPENPAX_EMUTRAMP_DEFAULT
	bool "Enable trampoline emulation by default"
	depends on OPENPAX_EMUTRAMP
	default y
	help
	  Enabling this option allows programs which require
	  trampolines to be emulated to continue working by default.

	  Otherwise, the emulation flag must be enabled in a binary's
	  PaX marking, e.g. with paxmark -E <binary>.

	  If you do not say 'y' here, you will have to manually mark
	  all programs which require trampoline emulation.

endmenu
```
